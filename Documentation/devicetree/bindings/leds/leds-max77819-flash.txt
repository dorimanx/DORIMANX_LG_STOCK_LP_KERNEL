## arch/arm/mach-msm/lge/Kconfig
```kconfig
config MACH_LGE
	bool

menu "LGE Board Selection"

source "arch/arm/mach-msm/lge/8974-g2/Kconfig"
source "arch/arm/mach-msm/lge/8974ac-g3/Kconfig"
source "arch/arm/mach-msm/lge/8974ac-dzny/Kconfig"

menuconfig LGE_SPECIFIC_PATCHES
    depends on MACH_LGE
    bool "LGE Specific Patches"

config DTS_TARGET
	string "DTS target dir"
	help
	  CONFIG_DTS_TARGET should be set to support appended dts.
	  ex) CONFIG_DTS_TARGET="msm8974-g3".

config LGE_HANDLE_PANIC
    tristate "Support LGE Kernel Panic Handler"
    default n
    depends on MACH_LGE
    help
      LGE Error handler

config LGE_BOOTLOADER_LOG
	tristate "Support LGE bootloader log"
	default n
	depends on MACH_LGE
	help
	  LGE bootloader log

config LGE_LCD_TUNING
	bool "lcd_gamma_tuning"
	default n
	depends on MACH_LGE
	help
	  Support LCD gamma tuning.

config LGE_PSEUDO_CHG_UI
	bool "Support pseudo charging UI"
	default n
	depends on MACH_LGE
	help
	  LGE PSEUDO CHG UI.

config LGE_BOOTLOADER_TIME_CHECKER
	bool "Show bootloader(LK, SBL) time"
	default n
	depends on MACH_LGE
	help
	  This shows the lk and sbl1 booting time in MSM8974.
	  If this feature is enabled, it should be check by adb shell.
	  Device Node : sys/module/lge_bootloader_time_checker/

config LGE_USES_SMD_DS_TTY
    bool "Explicitly use smd tty driver for DS"
	default n
	depends on MSM_SMD_TTY && MACH_LGE
	help
	  In Qualcomm MSM89xx, smd tty driver for ds(/dev/smd0) is not used.
	  Say yes if this tty driver must be used on LGE device. This is used
	  to connect smd channel in user space(for example, ATCMD processing).

config LGE_KSWITCH
    tristate "Support LGE Kill Switch"
    default n
    depends on MACH_LGE
    help
      LGE Kill Switch

config LCD_KCAL
	depends on MACH_LGE
	bool "Enable sysfs for LCD KCAL"
	default n

config LGE_QSDL_SUPPORT
    tristate "Support for Quality Statistics Data Logging"
    default n
    depends on MACH_LGE
    help
       QSDL is a feature which notify infomation for quality statistics
       data logging of device.

config LGE_QFPROM_INTERFACE
	bool "Support qfprom interface"
	default n
	depends on MACH_LGE
	help
	  LGE QFPROM DRIVER.


config LGE_DIAG_BYPASS
	tristate "Support LGE diag bypass for factory"
	default n
	depends on MACH_LGE
	help
	  LGE diag bypass


config LGE_LCD_OFF_DIMMING
	tristate "Support LGE LCD off dimming reboot"
	default n
	depends on MACH_LGE
	help
	  Support lcd off or dimming reboot when reboot reason is "LCD off". lcd stay dimming until lcd is off and on again.

config LGE_LIMIT_FREQ_TABLE
    bool "Set limitation to cpu frquency for manufacturing"
    default n
    depends on MACH_LGE
    help
      set limitation to cpu frquency for manufacturing

config LGE_GDSC_SWCONTROL
	bool "Support to use controlling gdsc by sw for msm8974AA"
	default n
	depends on MACH_LGE
	help
	  When enable this, LGE's sw control code for gdsc enable and diasble
	  are used. Normally, msm8974AA chipset based LGE model may use it.

endmenu
```

## drivers/broadcast/Kconfig
```kconfig
# LGE Broadcast Device Driver Support

menu "LGE Broadcast Device Support"


# config LGE_BROADCAST_ONESEG
#    bool "1Seg Broadcast service"
#    depends on (MACH_MSM8960_L_DCM)||(MACH_MSM8974_G2_DCM)||(MACH_MSM8974_G2_KDDI) || (MACH_MSM8974_Z_KDDI)
#    default y
#    help
#      Select this if you want to use Japanese 1Seg mobile broadcast service

#config LGE_BROADCAST_JFULLSEG
#    bool "Japan full-seg Broadcast service"
#    depends on (MACH_MSM8974_Z_KDDI) || (MACH_MSM8974_G3_KDDI_EVB) || (MACH_MSM8974_G3_KDDI)
#    default y
#    help
#      Select this if you want to use Japanese FullSeg mobile broadcast service

config LGE_BROADCAST_ISDBT_JAPAN
	bool "Japan full-seg Broadcast service"
	depends on (MACH_MSM8994_G4_KDDI_JP) || (MACH_MSM8974_DZNY_DCM)
	default y
	help
	  Select this if you want to use Japanese FullSeg mobile broadcast service

config LGE_BROADCAST_TDMB
    bool "LGE broadcast TDMB device Driver"
    depends on (MACH_MSM8974_G3_KR) || (MACH_MSM8974_G2_KR) || (MACH_MSM8974_B1_KR) || (MACH_MSM8974_TIGERS_KR)
    default y
    help
      Select this if you want to use TDMB broadcast service

source "drivers/broadcast/oneseg/Kconfig"
source "drivers/broadcast/tdmb/Kconfig"
endmenu
```

## drivers/broadcast/oneseg/Kconfig
```kconfig
#
# Broadcast Device Driver Support
#

menu "LGE Japanese Mobile Broadcast(ISDB-T 1seg/ISDB-Tmm 13seg) Device Support"
config LGE_BROADCAST_ONESEG_TCC3530
	bool "1Seg broacast tuner chipset tcc3530  device driver"
	depends on LGE_BROADCAST_ONESEG && MACH_APQ8064_F9J
	default y
	help
	  Select this if you want to use Japanese 1Seg mobile broadcast service

config LGE_BROADCAST_ONESEG_TCC3535
	bool "1Seg broacast tuner chipset tcc3535  device driver"
	depends on LGE_BROADCAST_JFULLSEG
	default y
	help
	  Select this if you want to use Japanese 1Seg mobile broadcast service
	  
config LGE_BROADCAST_ISDBT_JAPAN_FC8300
	bool "Japan FULL-SEG broacast tuner chipset FC8300 device driver"
	depends on (LGE_BROADCAST_ISDBT_JAPAN && MACH_MSM8974_DZNY_DCM) || (LGE_BROADCAST_ISDBT_JAPAN && MACH_MSM8994_G4_KDDI_JP)
	default y
	help
	  Select this if you want to use Japanese FULL-SEG service

endmenu
```

## drivers/broadcast/oneseg/fc8300/Kconfig
```kconfig
#
# FC8300_DEVICE subsystem configuration
#

#menu "FC8300 support"

config FC8300_ISDB_T
	default n
	---help---
	  This driver implements the front-end of the Xen virtual
	  keyboard and mouse device driver.  It communicates with a back-end
	  in another domain.
  
#endmenu
```

## drivers/broadcast/tdmb/Kconfig
```kconfig
#menu "BROADCAST_DEVICE"

#
# Broadcast Device Driver Support
#

#menu "BROADCAST_DEVICE"

config LGE_BROADCAST_TDMB_FC8050
    bool "LGE broacast TDMB FC8050 device"
    depends on (LGE_BROADCAST_TDMB && MACH_MSM8974_G2_KR)
    default y
    help
      Select this if you want to use broadcast service

config LGE_BROADCAST_TDMB_FC8080
    bool "LGE broacast TDMB FC8080 device"
    depends on (LGE_BROADCAST_TDMB && MACH_MSM8974_G3_KR) || (LGE_BROADCAST_TDMB && MACH_MSM8974_B1_KR) || (LGE_BROADCAST_TDMB && MACH_MSM8974_TIGERS_KR)
    default y
    help
      Select this if you want to use broadcast service

#config LGE_BROADCAST_TDMB_LG2102
#    bool "LGE broacast TDMB LG2102 device"
#    depends on LGE_BROADCAST_TDMB
#    default n
#    help
#      Select this if you want to use broadcast service

#config LGE_BROADCAST_TDMB_T3900
#    bool "LGE broacast TDMB T3900 device"
#    depends on LGE_BROADCAST_TDMB
#    default y
#    help
#      Select this if you want to use broadcast service

#config LGE_BROADCAST_TDMB_T39FX
#    bool "LGE broacast TDMB T39FX device"
#    depends on LGE_BROADCAST_TDMB
#    default y
#    help
#      Select this if you want to use broadcast service
#endmenu
```

## drivers/input/touchscreen/disney/DS5/Kconfig
```kconfig
config TOUCHSCREEN_SYNAPTICS_FW_PATH
	   string "Synaptics Touchscreen Firmware Path"
	   help
	      TOUCHSCREEN_SYNAPTICS_FW_PATH is set to path of synaptics firmware
	      in firmware/synaptics.
	      ex) TOUCHSCREEN_SYNAPTICS_FW_PATH="dzny_dcm_jp".
```

## drivers/input/touchscreen/disney/Kconfig
```kconfig
#
# Touchscreen driver configuration
#
config TOUCHSCREEN_SYNAPTICS_I2C_RMI
	tristate "Synaptics i2c touchscreen"
	depends on I2C
	help
	  This enables support for Synaptics RMI over I2C based touchscreens.

config TOUCHSCREEN_SYNAPTICS_RMI4_I2C
	tristate "Synaptics i2c touchscreen(ClearPad 3000)"
	depends on I2C
	select SYNA_MULTI_TOUCH
	help
	  This enables support for Synaptics RMI over I2C based touchscreens(ClearPad 3000).

config TOUCHSCREEN_SYNAPTICS_3404S
	tristate "Synaptics 3404S chip(G2)"
	help
	  This enables support for Synaptics 3404S chip for Touch Dirver.

config TOUCHSCREEN_SYNAPTICS_I2C_RMI4
	tristate "Synaptics DSX I2C touchscreen"
	depends on I2C
	help
	  Say Y here if you have a Synaptics DSX I2C touchscreen
	  connected to your system.

	  If unsure, say N.

	  To compile this driver as a module, choose M here: the
	  module will be called synaptics_i2c_rmi4.

config TOUCHSCREEN_SYNAPTICS_I2C_RMI4_EVB
	tristate "Synaptics DSX I2C touchscreen for EVB"
	depends on I2C
	help
	  Say Y here if you have a Synaptics DSX I2C EVB for LGU touchscreen
	  connected to your system.

	  If unsure, say N.

	  To compile this driver as a module, choose M here: the
	  module will be called synaptics_i2c_rmi4_evb.

config TOUCHSCREEN_SYNAPTICS_I2C_VU3EVB
	tristate "Synaptics DSX I2C touchscreen"
	depends on I2C
	help
	  Say Y here if you have a Synaptics DSX I2C touchscreen
	  connected to your system.

	  If unsure, say N.

	  To compile this driver as a module, choose M here: the
	  module will be called synaptics_i2c_rmi4.

config TOUCHSCREEN_SYNAPTICS_DSX_RMI4_DEV
	tristate "Synaptics I2C touchscreen rmi device"
	depends on TOUCHSCREEN_SYNAPTICS_I2C_RMI4
	help
	  This enables support for character device channel for Synaptics
	  RMI4 touchscreens.

	  Say Y here if you have a Synaptics DSX I2C touchscreen
	  connected to your system.

	  If unsure, say N.

	  To compile this driver as a module, choose M here: the
	  module will be called synaptics_dsx_rmi4_dev.

config TOUCHSCREEN_SYNAPTICS_DSX_FW_UPDATE
	tristate "Synaptics I2C touchscreen firmware update"
	depends on TOUCHSCREEN_SYNAPTICS_I2C_RMI4
	help
	  This enables support for firmware update for Synaptics RMI4
	  touchscreens.

	  Say Y here if you have a Synaptics DSX I2C touchscreen
	  connected to your system.

	  If unsure, say N.

	  To compile this driver as a module, choose M here: the
	  module will be called synaptics_dsx_fw_update.

if TOUCHSCREEN_SYNAPTICS_DISNEY

source "drivers/input/touchscreen/disney/DS5/Kconfig"

endif
```

## drivers/switch/Kconfig
```kconfig
menuconfig SWITCH
	tristate "Switch class support"
	help
	  Say Y here to enable switch class support. This allows
	  monitoring switches by userspace via sysfs and uevent.

if SWITCH

config SWITCH_GPIO
	tristate "GPIO Swith support"
	depends on GENERIC_GPIO
	help
	  Say Y here to enable GPIO based switch support.

config SWITCH_ARIZONA
	tristate "Arizona Switch support"
	default n
	depends on MFD_ARIZONA
	help
	  Say Y here to enable Arizona switch support.

config SWITCH_MAX1462X
	tristate "LGE Headset detection driver(MAX14628)"
	depends on MACH_LGE
	default n
	help
	  Say Y here to enable GPIO based switch support.

endif # SWITCH

config INPUT_MAX14688
	tristate "MAXIM MAX14688 headset jack detector support"
	depends on MACH_LGE
	help
	  This option enables device driver support for MAX14688, a headset jack
	  detection IC.

	  To compile this driver as module, choose M here: the
	  module will be called max14688.

config EARJACK_DEBUGGER
    bool "Earjack UART debugger support"
    default n
    help
      Support earjack type UART debugger cable
```

## drivers/video/msm/mdss/Kconfig
```kconfig
config FB_MSM_MDSS_WRITEBACK
	bool "MDSS Writeback Panel"
	---help---
	The MDSS Writeback Panel provides support for routing the output of
	MDSS frame buffer driver and MDP processing to memory.

config FB_MSM_MDSS_HDMI_PANEL
	depends on FB_MSM_MDSS
	bool "MDSS HDMI Tx Panel"
	default n
	---help---
	The MDSS HDMI Panel provides support for transmitting TMDS signals of
	MDSS frame buffer data to connected hdmi compliant TVs, monitors etc.

config FB_MSM_MDSS_HDMI_MHL_SII8334
	depends on FB_MSM_MDSS_HDMI_PANEL
	bool 'MHL SII8334 support '
	default n
	---help---
	  Support the HDMI to MHL conversion.
	  MHL (Mobile High-Definition Link) technology
	  uses USB connector to output HDMI content

config FB_MSM_MDSS_DSI_CTRL_STATUS
	tristate "DSI controller status check feature"
	---help---
	  Check DSI controller status periodically (default period is 5
	  seconds) by sending Bus-Turn-Around (BTA) command. If DSI controller
	  fails to acknowledge the BTA command, it sends PANEL_ALIVE=0 status
	  to HAL layer to reset the controller.

config FB_MSM_MDSS_MDP3
	depends on FB_MSM_MDSS
	bool "MDP3 display controller"
	---help---
	The MDP3 provides support for an older version display controller
	included in latest display sub-system, known as MDSS.
config LGE_VSYNC_SKIP
	bool "MDSS VSYNC Skip scheme"
	---help---
	This feature provides VSYNC skip scheme.

config LGE_SUPPORT_LCD_MAKER_ID
	depends on MACH_LGE
	default y
	bool "LGE LCD MAKER ID support configuration"
	help
	   Say Y here to enable support for LCD MAKER ID lge feature.
	   
config LGE_MIPI_DZNY_JDI_INCELL_FHD_VIDEO_PANEL
	bool "MIPI Disney JDI FHD LCD Video Panel"
	default n

config LGE_LION_DSV
	bool "LION_DSV Power Management chip"
	default n
```
