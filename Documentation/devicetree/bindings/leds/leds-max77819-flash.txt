## arch/arm/mach-msm/lge/8974-g2/Kconfig
```kconfig
config MACH_MSM8974_G2
	bool

config MACH_MSM8974_G2_KR
	depends on ARCH_MSM8974
	select MACH_LGE
	select MACH_MSM8974_G2
	bool "MSM8974 G2 KR"
	help
	  Support for the Qualcomm MSM8974 G2 Korea device.

config MACH_MSM8974_G2_LGU
	depends on ARCH_MSM8974
	select MACH_LGE
	select MACH_MSM8974_G2
	bool "MSM8974 G2 LGU"
	help
	  Support for the Qualcomm MSM8974 G2 LG Uplus device.

config MACH_MSM8974_G2_ATT
	depends on ARCH_MSM8974
	select MACH_LGE
	select MACH_MSM8974_G2
	bool "MSM8974 G2 ATT"
	help
	  Support for the Qualcomm MSM8974 G2 AT&T device.

config MACH_MSM8974_G2_SKT
	depends on ARCH_MSM8974
	select MACH_LGE
	select MACH_MSM8974_G2
	bool "MSM8974 G2 SKT"
	help
	  Support for the Qualcomm MSM8974 G2 SKT device.

config MACH_MSM8974_G2_KT
	depends on ARCH_MSM8974
	select MACH_LGE
	select MACH_MSM8974_G2
	bool "MSM8974 G2 KT"
	help
	  Support for the Qualcomm MSM8974 G2 KT device.

config MACH_MSM8974_G2_VZW
	depends on ARCH_MSM8974
	select MACH_LGE
	select MACH_MSM8974_G2
	bool "MSM8974 G2 VZW"
	help
	  Support for the Qualcomm MSM8974 G2 Verizon device.

config MACH_MSM8974_G2_SPR
	depends on ARCH_MSM8974
	select MACH_LGE
	select MACH_MSM8974_G2
	bool "MSM8974 G2 SPR"
	help
	  Support for the Qualcomm MSM8974 G2 SPRINT device.

config MACH_MSM8974_G2_TMO_US
	depends on ARCH_MSM8974
	select MACH_LGE
	select MACH_MSM8974_G2
	bool "MSM8974 G2 TMO_US"
	help
	  Support for the Qualcomm MSM8974 G2 TMUS device.

config MACH_MSM8974_G2_DCM
	depends on ARCH_MSM8974
	select MACH_LGE
	select MACH_MSM8974_G2
	bool "MSM8974 G2 DCM"
	help
	  Support for the Qualcomm MSM8974 G2 DCM device.

config MACH_MSM8974_G2_KDDI
	depends on ARCH_MSM8974
	select MACH_LGE
	select MACH_MSM8974_G2
	bool "MSM8974 G2 KDDI"
	help
	  Support for the Qualcomm MSM8974 G2 KDDI device.

config MACH_MSM8974_G2_OPEN_COM
	depends on ARCH_MSM8974
	select MACH_LGE
	select MACH_MSM8974_G2
	bool "MSM8974 G2 OPEN_COM"
	help
	  Support for the Qualcomm MSM8974 G2 OPEN device.

config MACH_MSM8974_G2_OPT_AU
	depends on ARCH_MSM8974
	select MACH_LGE
	select MACH_MSM8974_G2
	bool "MSM8974 G2 OPT_AU"
	help
	  Support for the Qualcomm MSM8974 G2 OPEN device.

config MACH_MSM8974_G2_TEL_AU
	depends on ARCH_MSM8974
	select MACH_LGE
	select MACH_MSM8974_G2
	bool "MSM8974 G2 TEL AU"
	help
	  Support for the Qualcomm MSM8974 G2 OPEN device.

config MACH_MSM8974_G2_CA
	depends on ARCH_MSM8974
	select MACH_LGE
	select MACH_MSM8974_G2
	bool "MSM8974 G2 CA"
	help
	  Support for the Qualcomm MSM8974 G2 Canada device.

config MACH_MSM8974_G2_BELL
	depends on ARCH_MSM8974
	select MACH_LGE
	select MACH_MSM8974_G2
	bool "MSM8974 G2 BELL"
	help
	  Support for the Qualcomm MSM8974 G2 BELL device.

config MACH_MSM8974_G2_TLS
	depends on ARCH_MSM8974
	select MACH_LGE
	select MACH_MSM8974_G2
	bool "MSM8974 G2 TLS"
	help
	  Support for the Qualcomm MSM8974 G2 BELL device.

config MACH_MSM8974_G2_RGS
	depends on ARCH_MSM8974
	select MACH_LGE
	select MACH_MSM8974_G2
	bool "MSM8974 G2 RGS"
	help
	  Support for the Qualcomm MSM8974 G2 BELL device.

config MACH_MSM8974_G2_VTR
	depends on ARCH_MSM8974
	select MACH_LGE
	select MACH_MSM8974_G2
	bool "MSM8974 G2 VTR"
	help
	  Support for the Qualcomm MSM8974 G2 VTR device.

config MACH_MSM8974_G2_WIN
	depends on ARCH_MSM8974
	select MACH_LGE
	select MACH_MSM8974_G2
	bool "MSM8974 G2 WIN"
	help
	  Support for the Qualcomm MSM8974 G2 WIN device.

config MACH_MSM8974_Z_KR
	depends on ARCH_MSM8974
	select MACH_LGE
	select MACH_MSM8974_G2
	bool "MSM8974 Z KR"
	help
	  Support for the Qualcomm MSM8974 Z Korea device.

config MACH_MSM8974_Z_LGU
	depends on ARCH_MSM8974
	select MACH_LGE
	select MACH_MSM8974_G2
	bool "MSM8974 Z LGU"
	help
	  Support for the Qualcomm MSM8974 Z LG Uplus device.

config MACH_MSM8974_Z_US
	depends on ARCH_MSM8974
	select MACH_LGE
	select MACH_MSM8974_G2
	bool "MSM8974 Z US"
	help
	  Support for the Qualcomm MSM8974 Z United State device.

config MACH_MSM8974_Z_CN
	depends on ARCH_MSM8974
	select MACH_LGE
	select MACH_MSM8974_G2
	bool "MSM8974 Z CN"
	help
	  Support for the Qualcomm MSM8974 Z China device.

config MACH_MSM8974_Z_SPR
	depends on ARCH_MSM8974
	select MACH_LGE
	select MACH_MSM8974_G2
	bool "MSM8974 Z SPR"
	help
	  Support for the Qualcomm MSM8974 Z Sprint device.

config MACH_MSM8974_Z_TMO_US
	depends on ARCH_MSM8974
	select MACH_LGE
	select MACH_MSM8974_G2
	bool "MSM8974 Z TMO US"
	help
	  Support for the Qualcomm MSM8974 TMUS device.

config MACH_MSM8974_Z_ATT_US
	depends on ARCH_MSM8974
	select MACH_LGE
	select MACH_MSM8974_G2
	bool "MSM8974 Z ATT US"
	help
	  Support for the Qualcomm MSM8974 Z ATT device.

config MACH_MSM8974_Z_OPEN_COM
	depends on ARCH_MSM8974
	select MACH_LGE
	select MACH_MSM8974_G2
	bool "MSM8974 Z OPEN COM"
	help
	  Support for the Qualcomm MSM8974 Z OPEN device.

config MACH_MSM8974_Z_CTC_CN
	depends on ARCH_MSM8974
	select MACH_LGE
	select MACH_MSM8974_G2
	bool "MSM8974 Z CTC CN"
	help
	  Support for the Qualcomm MSM8974 Z CTC device.

config MACH_MSM8974_VU3_KR
	depends on ARCH_MSM8974
	select MACH_LGE
	select MACH_MSM8974_G2
	bool "MSM8974 VU3 KR"
	help
	  Support for the Qualcomm MSM8974 VU3 Korea device.

config MACH_MSM8974_VU3_LGU
	depends on ARCH_MSM8974
	select MACH_LGE
	select MACH_MSM8974_G2
	bool "MSM8974 VU3 LGU"
	help
	  Support for the Qualcomm MSM8974 VU3 LG Uplus device.

config MACH_MSM8974_VU3_SKT
	depends on ARCH_MSM8974
	select MACH_LGE
	select MACH_MSM8974_G2
	bool "MSM8974 VU3 SKT"
	help
	  Support for the Qualcomm MSM8974 VU3 SKT device.

config MACH_MSM8974_VU3_KT
	depends on ARCH_MSM8974
	select MACH_LGE
	select MACH_MSM8974_G2
	bool "MSM8974 VU3 KT"
	help
	  Support for the Qualcomm MSM8974 VU3 KT device.

config MACH_MSM8974_Z_SKT
	depends on ARCH_MSM8974
	select MACH_LGE
	select MACH_MSM8974_G2
	bool "MSM8974 Z SKT"
	help
	  Support for the Qualcomm MSM8974 Z SKT device.

config MACH_MSM8974_Z_KT
	depends on ARCH_MSM8974
	select MACH_LGE
	select MACH_MSM8974_G2
	bool "MSM8974 Z KT"
	help
	  Support for the Qualcomm MSM8974 Z KT device.

config MACH_MSM8974_G2_OPEN_AME
	depends on ARCH_MSM8974
	select MACH_LGE
	select MACH_MSM8974_G2
	bool "MSM8974 G2 OPEN_AME"
	help
	  Support for the Qualcomm MSM8974 G2 OPEN device.

config MACH_MSM8974_Z_KDDI
	depends on ARCH_MSM8974
	select MACH_LGE
	select MACH_MSM8974_G2
	bool "MSM8974 Z KDDI"
	help
	  Support for the Qualcomm MSM8974 Z KDDI device.

config MACH_MSM8974_Z_CA
    depends on ARCH_MSM8974
    select MACH_LGE
    select MACH_MSM8974_G2
    bool "MSM8974 Z CA"
    help
      Support for the Qualcomm MSM8974 Z Canada device.

config MACH_MSM8974_Z_RGS
    depends on ARCH_MSM8974
    select MACH_LGE
    select MACH_MSM8974_G2
    bool "MSM8974 Z RGS"
    help
      Support for the Qualcomm MSM8974 Z RGS device.

config MACH_MSM8974_B1_KR
        depends on ARCH_MSM8974
        select MACH_LGE
	select MACH_MSM8974_G2
        bool "MSM8974 B1 KR"
        help
          Support for the Qualcomm MSM8974 B1 Korea device.

config MACH_MSM8974_B1_LGU
        depends on ARCH_MSM8974
        select MACH_LGE
	select MACH_MSM8974_G2
        bool "MSM8974 B1 LGU"
        help
          Support for the Qualcomm MSM8974 B1 LG Uplus device.

config MACH_MSM8974_B1_SKT
        depends on ARCH_MSM8974
        select MACH_LGE
	select MACH_MSM8974_G2
        bool "MSM8974 B1 SKT"
        help
          Support for the Qualcomm MSM8974 B1 SKT device.

config MACH_MSM8974_B1_KT
        depends on ARCH_MSM8974
        select MACH_LGE
	select MACH_MSM8974_G2
        bool "MSM8974 B1 KT"
        help
          Support for the Qualcomm MSM8974 B1 KT device.

config MACH_MSM8974_B1W
        depends on ARCH_MSM8974
        select MACH_LGE
	select MACH_MSM8974_G2
        bool "MSM8974 B1W"
        help
          Support for the Qualcomm MSM8974 B1W device.

config MACH_MSM8974_B1W_OPEN_TW
        depends on ARCH_MSM8974
        select MACH_LGE
	select MACH_MSM8974_G2
        bool "MSM8974 B1W OPEN TW"
        help
          Support for the Qualcomm MSM8974 B1W OPEN TW device.

config MACH_MSM8974_B1W_OPEN_COM
        depends on ARCH_MSM8974
        select MACH_LGE
	select MACH_MSM8974_G2
        bool "MSM8974 B1W OPEN COM"
        help
          Support for the Qualcomm MSM8974 B1W OPEN COM device.

config MACH_MSM8974_B1W_OPEN_SG
        depends on ARCH_MSM8974
        select MACH_LGE
	select MACH_MSM8974_G2
        bool "MSM8974 B1W OPEN SG"
        help
          Support for the Qualcomm MSM8974 B1W OPEN SG device.

config MACH_MSM8974_B1W_OPEN_HK
        depends on ARCH_MSM8974
        select MACH_LGE
	select MACH_MSM8974_G2
        bool "MSM8974 B1W OPEN HK"
        help
          Support for the Qualcomm MSM8974 B1W OPEN HK device.

config MACH_MSM8974_TIGERS_KR
        depends on ARCH_MSM8974
        select MACH_LGE
	select MACH_MSM8974_G2
        bool "MSM8974 TIGERS KR"
        help
          Support for the Qualcomm MSM8974 TIGERS Korea device.

config MACH_MSM8974_TIGERS_SKT
        depends on ARCH_MSM8974
        select MACH_LGE
	select MACH_MSM8974_G2
        bool "MSM8974 TIGERS SKT"
        help
          Support for the Qualcomm MSM8974 TIGERS SKT device.
```

## arch/arm/mach-msm/lge/8974ac-dzny/Kconfig
```kconfig
config MACH_MSM8974_DZNY
	bool

config MACH_MSM8974_DZNY_DCM
	depends on ARCH_MSM8974
	select MACH_LGE
	select MACH_MSM8974_DZNY
	bool "MSM8974 DZNY DCM"
	help
	  Support for the Qualcomm MSM8974 DZNY DCM device.
```

## arch/arm/mach-msm/lge/8974ac-g3/Kconfig
```kconfig
config MACH_MSM8974_G3
	bool

config MACH_MSM8974_G3_KR
	depends on ARCH_MSM8974
	select MACH_LGE
	select MACH_MSM8974_G3
	bool "MSM8974 G3 KR"
	help
	  Support for the Qualcomm MSM8974 G3 KR device.

config MACH_MSM8974_G3_LGU
	depends on ARCH_MSM8974
	select MACH_LGE
	select MACH_MSM8974_G3
	bool "MSM8974 G3 LGU"
	help
	  Support for the Qualcomm MSM8974 G3 LG Uplus device.

config MACH_MSM8974_G3_LGU_EVB
	depends on ARCH_MSM8974
	select MACH_LGE
	select MACH_MSM8974_G3
	bool "MSM8974 G3 LGU EVB"
	help
	  Support for the Qualcomm MSM8974 G3 LG Uplus EVB device.

config MACH_MSM8974_G3_SKT
	depends on ARCH_MSM8974
	select MACH_LGE
	select MACH_MSM8974_G3
	bool "MSM8974 G3 SKT"
	help
	  Support for the Qualcomm MSM8974 G3 SKT device.

config MACH_MSM8974_G3_KT
	depends on ARCH_MSM8974
	select MACH_LGE
	select MACH_MSM8974_G3
	bool "MSM8974 G3 KT"
	help
	  Support for the Qualcomm MSM8974 G3 KT device.

config MACH_MSM8974_G3_VZW
	depends on ARCH_MSM8974
	select MACH_LGE
	select MACH_MSM8974_G3
	bool "MSM8974 G3 VZW"
	help
	  Support for the Qualcomm MSM8974 G3 Verizon device.

config MACH_MSM8974_G3_LRA
	depends on ARCH_MSM8974
	select MACH_LGE
	select MACH_MSM8974_G3
	bool "MSM8974 G3 LRA"
	help
	  Support for the Qualcomm MSM8974 G3 LRA device.

config MACH_MSM8974_G3_ATT
	depends on ARCH_MSM8974
	select MACH_LGE
	select MACH_MSM8974_G3
	bool "MSM8974 G3 ATT"
	help
	  Support for the Qualcomm MSM8974 G3 AT&T device.

config MACH_MSM8974_G3_SPR_US
	depends on ARCH_MSM8974
	select MACH_LGE
	select MACH_MSM8974_G3
	bool "MSM8974 G3 SPR US"
	help
	  Support for the Qualcomm MSM8974 G3 Sprint device.

config MACH_MSM8974_G3_USC_US
	depends on ARCH_MSM8974
	select MACH_LGE
	select MACH_MSM8974_G3
	bool "MSM8974 G3 USC US"
	help
	  Support for the Qualcomm MSM8974 G3 Usc device.

config MACH_MSM8974_G3_ACG_US
	depends on ARCH_MSM8974
	select MACH_LGE
	select MACH_MSM8974_G3
	bool "MSM8974 G3 ACG US"
	help
	  Support for the Qualcomm MSM8974 G3 ACG device.

config MACH_MSM8974_G3_TMO_US
	depends on ARCH_MSM8974
	select MACH_LGE
	select MACH_MSM8974_G3
	bool "MSM8974 G3 TMO US"
	help
	  Support for the Qualcomm MSM8974 G3 AT&T device.

config MACH_MSM8974_G3_CN
	depends on ARCH_MSM8974
	select MACH_LGE
	select MACH_MSM8974_G3
	bool "MSM8974 G3 CN"
	help
	  Support for the Qualcomm MSM8974 G3 CHINA device.

config MACH_MSM8974_G3_CMCC_CN
	depends on ARCH_MSM8974
	select MACH_LGE
	select MACH_MSM8974_G3
	bool "MSM8974 G3 CMCC CN"
	help
	  Support for the Qualcomm MSM8974 G3 CMCC device.

config MACH_MSM8974_G3_CTC_CN
	depends on ARCH_MSM8974
	select MACH_LGE
	select MACH_MSM8974_G3
	bool "MSM8974 G3 CTC CN"
	help
	  Support for the Qualcomm MSM8974 G3 CTC device.

config MACH_MSM8974_G3_CUCC_CN
	depends on ARCH_MSM8974
	select MACH_LGE
	select MACH_MSM8974_G3
	bool "MSM8974 G3 CUCC CN"
	help
	  Support for the Qualcomm MSM8974 G3 CUCC device.

config MACH_MSM8974_G3_OPEN_HK
	depends on ARCH_MSM8974
	select MACH_LGE
	select MACH_MSM8974_G3
	bool "MSM8974 G3 OPEN HK"
	help
	  Support for the Qualcomm MSM8974 G3 OPEN_HK device.

config MACH_MSM8974_G3_KDDI
	depends on ARCH_MSM8974
	select MACH_LGE
	select MACH_MSM8974_G3
	bool "MSM8974 G3 KDDI"
	help
	  Support for the Qualcomm MSM8974 G3 KDDI device.

config MACH_MSM8974_G3_KDDI_EVB
	depends on ARCH_MSM8974
	select MACH_LGE
	select MACH_MSM8974_G3
	bool "MSM8974 G3 KDDI EVB"
	help
	  Support for the Qualcomm MSM8974 G3 LG KDDI EVB device.

config MACH_MSM8974_G3_GLOBAL_COM
	depends on ARCH_MSM8974
	select MACH_LGE
	select MACH_MSM8974_G3
	bool "MSM8974 G3 GLOBAL COM"
	help
	  Support for the Qualcomm MSM8974 G3 GLOBAL device.

config MACH_MSM8974_G3_CA
	depends on ARCH_MSM8974
	select MACH_LGE
	select MACH_MSM8974_G3
	bool "MSM8974 G3 CA"
	help
	  Support for the Qualcomm MSM8974 G3 Canada device.

config MACH_MSM8974_G3_BELL
	depends on ARCH_MSM8974
	select MACH_LGE
	select MACH_MSM8974_G3
	bool "MSM8974 G3 BELL"
	help
	  Support for the Qualcomm MSM8974 G3 BELL device.

config MACH_MSM8974_G3_TLS
	depends on ARCH_MSM8974
	select MACH_LGE
	select MACH_MSM8974_G3
	bool "MSM8974 G3 TLS"
	help
	  Support for the Qualcomm MSM8974 G3 TLS device.

config MACH_MSM8974_G3_RGS
	depends on ARCH_MSM8974
	select MACH_LGE
	select MACH_MSM8974_G3
	bool "MSM8974 G3 RGS"
	help
	  Support for the Qualcomm MSM8974 G3 RGS device.

config MACH_MSM8974_G3_VTR
	depends on ARCH_MSM8974
	select MACH_LGE
	select MACH_MSM8974_G3
	bool "MSM8974 G3 VTR"
	help
	  Support for the Qualcomm MSM8974 G3 VTR device.

config MACH_MSM8974_G3_WIN
	depends on ARCH_MSM8974
	select MACH_LGE
	select MACH_MSM8974_G3
	bool "MSM8974 G3 WIN"
	help
	  Support for the Qualcomm MSM8974 G3 WIN device.
```
