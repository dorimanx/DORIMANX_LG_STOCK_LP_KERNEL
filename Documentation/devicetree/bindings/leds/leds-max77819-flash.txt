## Documentation/devicetree/bindings/leds/leds-max77819-flash.txt
```
Device Tree bindings for max77819 Flash

Valid node name : flash

Optional properties for regulator:
 - flash-en-control : Boolean. Flash triggered by FLASHEN pin.
 - torch-en-control : Boolean. Flash triggered by TORCHEN pin.
 - enable-maxflash : Boolean. MaxFlash function enable/disable.
 - maxflash-threshold : Integer. Max Flash Low battery detection threshold.
		2400000uV to 3400000uV in 33333uV steps.
 - maxflash-hysteresis: Integer. Low battery detection hysteresis.
		One of 100000uV, 200000uV, 300000uV or -1. -1 means disabled.
 - maxflash-falling-timer : Integer. Low Battery mask timer for falling edge of battery.
		256us to 2048us in 256us steps.
 - maxflash-rising-timer : Integer. Low Battery mask timer for rising edge of battery.
		256us to 2048us in 256us steps.

Example:

	flash {
		flash-en-control;
		enable-maxflash;
	};
```

## Documentation/devicetree/bindings/mfd/max77819.txt
```
Maxim MAX77819 multi-functional device

MAX77819 is a Mulitifunction device with Charger, SFO and etc.

* PMIC *
Required properties:
 - compatible : Must be "maxim,max77819-pmic".
 - interrupt-parent : The parent interrupt controller.
 - interrupts : Interrupt number.
 - interrupt-controller : Mark the device node as an interrupt controller.
 - #interrupt-cells : Should be four.

Nodes:
- charger
- sfo
- flah

* Peripheral *
Required properties:
 - compatible : Must be "maxim,max77819-periph".

Nodes:
- wled
- vibrator


Example:
	max77819_0: max77819@66 {
		compatible = "maxim,max77819-pmic";
		#address-cells = <0>;
		max77819,int-gpio = //TBD
		interrupt-parent = //TBD
		interrupts = //TBD
		interrupt-controller;
		#interrupt-cells = <1>;
		reg = <0x66>;
		status = "ok";

		sfo {
			//TBD
		};

		charger {
			compatible = "maxim,max77819-charger";
			status = "ok";
			interrupt-parent = <&max77819_0>;
			interrupts = <0>;
			psy_name = "ac";
			ext_psy_name = "usb";
			supplied_to = "battery";
			fast_charge_current = <1500000>;
			charge_termination_voltage = <4350000>;
			topoff_timer = <0>;
			topoff_current = <200000>;
			charge_restart_threshold = <150000>;
			coop_psy_name = //TBD
			enable_thermistor;
			enable_aicl;
			aicl_detection_voltage = <4500000>;
			aicl_reset_threshold = <100000>;
			current_limit_usb = <500000>;
			current_limit_ac = <1500000>;
		};

		flash {
			//TBD
		};

	max77819_1: max77819@48 {
		//TBD

		vibrator {
			//TBD
		};
	};
```

## Documentation/devicetree/bindings/misc/max77819-vibrator.txt
```
max77819 Vibrator bindings

Valid node name : vibrator

Optional properties :
 - current : Integer. 1000uA to 140000uA.

Example:
	vibrator {
		current = <30>;
	};
```

## Documentation/devicetree/bindings/platform/device_name.txt
```
Setting simple platform device name

In case of legacy platform bus, device name could be set to combination
with name and id of device in platform data of machine-board file.
Especially, device name was same as platform device name itself when
device id is -1.

Now, in the age of device tree, platform device name consists of node name
and unique id from global atomic value which are increased by registering
order. So, this name has variant by device environment even though it points
to same device. For example, simple platform device, "simple_dev" supports
sysfs for user space to provide device information may have name as
"simple_dev.95" in A device. But, same platform device in B devices may have
"simple_dev.83" as name. Therefore, user space can't determine proper sysfs
to get the information.

Of course, this can be solved by using class driver. But, to simple platform
driver like "simple_dev" as above example, usage of class driver is cost-waste.

By this reason, it introduces two properties as following;

- platform,dev,id
- platform,dev,name

If platform,dev,id and platform,dev,name are exist both, name is assigned to
[name].[id].

If platform,dev,id is 0 and platform,dev,name is exist, name is assigned to
[name].

If platform,dev,id is exist only, name is assigned to [node name].[id].

If platform,dev,id is not exist(at this time, existence of name is not care),
name is followed by original setting([node name].[unique id by atomic value]).

Example:
&soc {
	...
	platform,device,A@0 {
		#address-cells = <1>;
		#size-cells = <0>;
		interrupt-controller;
		#interrupt-cells = <3>;

		/* /sys/devices/sim/... */
		platform,dev,id = <0>;
		platform,dev,name = "sim";
	};

	platform,device,B@1 {
		#address-cells = <1>;
		#size-cells = <0>;
		interrupt-controller;
		#interrupt-cells = <3>;

		/* /sys/devices/sim.32/... */
		platform,dev,id = <32>;
		platform,dev,name = "sim";

	};

	platform,device,C@1 {
		#address-cells = <1>;
		#size-cells = <0>;
		interrupt-controller;
		#interrupt-cells = <3>;

		/* maybe /sys/devices/platform,device,C.36/... */
		platform,dev,name = "sim";
	};

	...
};
```

## Documentation/devicetree/bindings/power_supply/max17048.txt
```
max17048 bindings

Required properties :
 - compatible : "maxim,max17048"
 - model-data : Short Integer[32]

Optional properties :
 - rcomp : compensates the model for different lithium chemistries.
 - empty-alert-threshold : the SOC threshold, where an interrupt is generated on the ALRT pin
		and can be programmed from 1% up to 32%
 - voltage-alert-threshold : Voltage alert maximum alerts.
		It can be programmed from 0uV to 5120000uV.

Example:
	max17048@36 {
		compatible = "maxim,max17048";
		rcomp = <151>;
		empty-alert-threshold = <4>;
		model-data = <...>;
	};
```

## Documentation/devicetree/bindings/power_supply/max77819-charger.txt
```
Device Tree bindings for max77819 Charger

Required Properties :
 - compatible : Should be "maxim,max77819-charger".

Optional Properties :
 - psy_name : Power supply name.
 - fast_charge_current : fast charge current(uA)
 - charge_termination_voltage : CV voltage(uV)
 - topoff_timer : topoff timer(min)
 - topoff_current : topoff current (uA)
 - charge_restart_threshold : restart charging threshold (uV)
 - enable_coop : enable dual charging with MAX8971.
		If you use only MAX77819 charger, you should not define it.
 - coop_psy_name : cooperation power supply name if you use dual charging.
 - enable_thermistor : Enable thermistor
 - enable_aicl : enable AICL function.
 - aicl_detection_voltage : AICL detection voltage(uV)
 - aicl_reset_threshold : AICL reset threshold(uV)


Example:

		charger {
			compatible = "maxim,max77819-charger";
			psy_name = "max77819-charger";
			fast_charge_current = <0>;
			enable_thermistor;
			enable_aicl;
			aicl_detection_voltage = <4500000>;
			aicl_reset_threshold = <100000>;
		};
```

## Documentation/devicetree/bindings/regulator/max77819-sfo.txt
```
Device Tree regulator bindings for max77819 SFO

Optional properties for regulator:
 - active-discharge : bool: Turn ON Active Discharge
 - Any optional property defined in bindings/regulator/regulator.txt

The valid names for regulators are:
	safeout

Example:

	safeout {
		regulator-min-microvolt = <500000>;
		regulator-max-microvolt = <500000>;
	};
```

## Documentation/devicetree/bindings/video/backlight/lm3697_bl.txt
```
TI LM3697 backlight device tree bindings

Required properties:
  - compatible: "ti,lm3697"

Optional properties: Only specified in PWM brightness control mode
  - pwms: OF device-tree PWM specification.
  - pwm-names: a list of names for the PWM devices specified in the "pwms"
               property.
  For the PWM user nodes, please refer to
  Documentation/devicetree/bindings/pwm/pwm.txt.

Sub-nodes:
  LM3697 backlight should have backlight device specifiers in each sub-node.
  Each sub-node exactly matches with backlight control bank configuration.
  Maximum number of sub-nodes is 2.

  Required properties of sub-node:
  - hvled1-used, hvled2-used, hvled3-used: Backlight string configuration about
                                           which backlight string is used.

  Optional properties of sub-node:
  - backlight-name: Name string for backlight device identification
  - max-current-milliamp: Max current setting. Type is <u32>. Unit is mA.
                          Range is from 5 to 30mA.
  - initial-brightness: Backlight initial brightness. Type is <u32>.
                        Range is from 0 to 2047.
  - pwm-period: PWM period. Only valid in PWM brightness mode. Type is <u32>.

Examples:

One backlight device is defined. It's PWM based control with period 10KHz.

lm3697@36 {
	compatible = "ti,lm3697";
	reg = <0x36>;

	/* GPIO134 for HWEN pin */
	ti,enable-gpio = <&gpio5 6 0>;

	pwms = <&pwm3943 1 10000>;
	pwm-names = "lm3697-backlight";

	lcd_bl {
		backlight-name = "lcd";
		hvled1-used;
		hvled2-used;
		hvled3-used;

		max-current-milliamp = <20>;
		initial-brightness = <2000>;
		pwm-period = <10000>;
	};
};

Brightness register base, two backlight devices are configured,
'lcd' and 'status'. The 'lcd' is connected to HVLED1 and 2.
The 'status' is connected to HVLED3.

lm3697@36 {
	compatible = "ti,lm3697";
	reg = <0x36>;

	/* GPIO134 for HWEN pin */
	ti,enable-gpio = <&gpio5 6 0>;

	lcd_bl {
		backlight-name = "lcd";
		hvled1-used;
		hvled2-used;

		max-current-milliamp = <20>;
		initial-brightness = <10>;
	};

	status {
		backlight-name = "status";
		hvled3-used;

		max-current-milliamp = <10>;
		initial-brightness = <20>;
	};
};
```

## Documentation/devicetree/bindings/video/backlight/max77819_bl.txt
```
max77819 backlight bindings

Valid node name : backlight

Optional properties :
 - current_map_id : currently, don't care
 - ramp_up_time_msec : ramp-up timer.
 - ramp_dn_time_msec : ramp-down timer.
 - pwm_input_use : It should be one of follow vaules
		0 - MAX77819_WLED_PWM_INPUT_DISABLE  ignoring WLEDPWM input
		1 - MAX77819_WLED_PWM_INPUT_CABC     CABC dimming signal
		2 - MAX77819_WLED_PWM_INPUT_EXTRA    extra control signal for higher resolution in brightness levels
 - pwm_id : PWM ID of AP.
		It will be used when "pwm_input_use == MAX77819_WLED_PWM_INPUT_EXTRA"
 - pwm_period_nsec : PWM period in nsec.
		It will be used when "pwm_input_use == MAX77819_WLED_PWM_INPUT_EXTRA"
Example:
	backlight {
		compatible = "maxim,max77819-wled";
		pwm_input_use = 2;
		pwm_id = 1;
		pwm_period_nsec = 1024*20;
	};
```
