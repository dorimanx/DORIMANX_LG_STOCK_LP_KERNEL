/* Copyright (c) 2013, The Linux Foundation. All rights reserved.
 *
 * This program is free software; you can redistribute it and/or modify
 * it under the terms of the GNU General Public License version 2 and
 * only version 2 as published by the Free Software Foundation.
 *
 * This program is distributed in the hope that it will be useful,
 * but WITHOUT ANY WARRANTY; without even the implied warranty of
 * MERCHANTABILITY or FITNESS FOR A PARTICULAR PURPOSE.  See the
 * GNU General Public License for more details.
 */


&sdhc_1 {
	qcom,clk-rates = <400000 20000000 25000000 50000000 100000000 192000000 384000000>;
	qcom,bus-speed-mode = "HS400_1p8v", "HS200_1p8v", "DDR_1p8v";
	qcom,pad-pull-off = <0x0 0x3 0x3 0x1>;
	qcom,pad-pull-on = <0x0 0x3 0x3 0x1>;

	qcom,msm-bus,num-cases = <9>;
	qcom,msm-bus,num-paths = <1>;
	qcom,msm-bus,vectors-KBps = <78 512 0 0>, /* No vote */
			<78 512 1600 3200>,    /* 400 KB/s*/
			<78 512 80000 160000>, /* 20 MB/s */
			<78 512 100000 200000>, /* 25 MB/s */
			<78 512 200000 400000>, /* 50 MB/s */
			<78 512 400000 800000>, /* 100 MB/s */
			<78 512 800000 1600000>, /* 200 MB/s */
			<78 512 800000 1600000>, /* 400 MB/s */
			<78 512 2048000 4096000>; /* Max. bandwidth */
	qcom,bus-bw-vectors-bps = <0 400000 20000000 25000000 50000000 100000000 200000000 400000000 4294967295>;
};
